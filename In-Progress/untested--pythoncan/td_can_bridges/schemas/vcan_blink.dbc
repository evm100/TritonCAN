VERSION "1.0"

NS_ :

BS_:

BU_: device_a device_b

BO_ 512 BlinkFromA: 2 device_a
 SG_ blink_state : 0|8@1+ (1,0) [0|255] ""  device_b
 SG_ sequence : 8|8@1+ (1,0) [0|255] ""  device_b

BO_ 513 BlinkFromB: 2 device_b
 SG_ blink_state : 0|8@1+ (1,0) [0|255] ""  device_a
 SG_ sequence : 8|8@1+ (1,0) [0|255] ""  device_a

CM_ BO_ 512 "Virtual blink command from device A to device B";
CM_ BO_ 513 "Virtual blink command from device B to device A";
CM_ SG_ 512 blink_state "Blink state 0=off, 1=on";
CM_ SG_ 512 sequence "Monotonic counter from device A";
CM_ SG_ 513 blink_state "Blink state 0=off, 1=on";
CM_ SG_ 513 sequence "Monotonic counter from device B";
