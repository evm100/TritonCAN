## Firmware/nativeCAN/USB_CAN_esp32s3/sdkconfig.defaults
```kconfig
CONFIG_ESP_CONSOLE_USB_SERIAL_JTAG=n
CONFIG_ESP_CONSOLE_UART_DEFAULT=y
CONFIG_TINYUSB=y
CONFIG_TINYUSB_ENABLED=y
CONFIG_ESP32S3_INTR_ALLOC_OPTIONS=y
CONFIG_ESP_DEFAULT_CPU_FREQ_MHZ_240=y
```

## Firmware/twai_motor_demo/main/Kconfig.projbuild
```kconfig
menu "TWAI Motor Demo Configuration"

config TWAI_RS02_MOTOR_ID
    int "RS02 motor CAN ID"
    range 0 255
    default 1
    help
        Select the node ID used when addressing the RoboStride RS02 actuator over CAN.
        The value must match the device's configured CAN ID (Communication Type 7).

config TWAI_RS02_MASTER_ID
    int "Host controller CAN ID"
    range 0 65535
    default 0
    help
        Configure the master/controller identifier that the RS02 expects in the
        extended CAN identifier's data field for enable/stop frames.

endmenu
```

## Firmware/twai_motor_demo/sdkconfig.defaults
```kconfig
CONFIG_IDF_TARGET="esp32c3"
CONFIG_ESP_CONSOLE_UART_DEFAULT=y
CONFIG_TWAI_RS02_MOTOR_ID=1
CONFIG_TWAI_RS02_MASTER_ID=0
```

## esp32s3_usb_can_slcan/main/Kconfig.projbuild
```kconfig
menu "SLCAN Bridge Options"
    config SLCAN_DEFAULT_BITRATE
        int "Default CAN bitrate (bps)"
        default 500000
        help
          Default bitrate used on startup. SLCAN 'Sx' can switch before 'O'.
          Common: 125000, 250000, 500000, 1000000

    config SLCAN_TWAI_TX_GPIO
        int "TWAI TX GPIO"
        default 5

    config SLCAN_TWAI_RX_GPIO
        int "TWAI RX GPIO"
        default 4
endmenu
```

## esp32s3_usb_can_slcan/sdkconfig.defaults
```kconfig
# --- TinyUSB CDC device ---
CONFIG_TINYUSB_ENABLED=y
CONFIG_TINYUSB_DEVICE_ENABLED=y
CONFIG_TINYUSB_CDC_ENABLED=y
CONFIG_TINYUSB_DESC_USE_ESPRESSIF_VID_PID=y
CONFIG_TINYUSB_DESC_CUSTOM_PID=0x7D01

# --- USB settings ---
CONFIG_USB_DEVICE_ENABLED=y
CONFIG_USB_OTG_ENABLED=y
CONFIG_USB_CDC_ENABLED=y
CONFIG_ESP_CONSOLE_USB_CDC=y
CONFIG_ESP_CONSOLE_NONE=n
CONFIG_ESP_CONSOLE_UART_DEFAULT=n
CONFIG_ESP_CONSOLE_USB_CDC_BOOT_TIMEOUT_MS=0

# --- TWAI (CAN) ---
CONFIG_TWAI_ISR_IN_IRAM=y

# --- Logging (feel free to tune) ---
CONFIG_LOG_DEFAULT_LEVEL_INFO=y
CONFIG_LOG_COLORS=y

# Reduce noise from Wi-Fi/Bluetooth; we don't need them.
CONFIG_ESP_WIFI_ENABLED=n
CONFIG_BT_ENABLED=n
```

## twai_motor_transmitter/main/Kconfig.projbuild
```kconfig
menu "TWAI Motor Demo Configuration"

config TWAI_RS02_MOTOR_ID
    int "RS02 motor CAN ID"
    range 0 255
    default 1
    help
        Select the node ID used when addressing the RoboStride RS02 actuator over CAN.
        The value must match the device's configured CAN ID (Communication Type 7).

endmenu
```

## twai_motor_transmitter/sdkconfig.defaults
```kconfig
CONFIG_IDF_TARGET="esp32c3"
CONFIG_ESP_CONSOLE_UART_DEFAULT=y
CONFIG_TWAI_RS02_MOTOR_ID=1
```
