VERSION ""

NS_ :

BS_:

BU_: Vector

BO_ 512 FootForce: 8 Vector
 SG_ forceN : 0|16@1+ (1,0) [0|65535] "N" Vector

BO_ 513 Sensors_Calib: 8 Vector
 SG_ mode : 0|8@1+ (1,0) [0|255] "" Vector

BO_ 514 IMU_Data: 8 Vector
 SG_ temp_C : 0|16@1+ (0.1,0) [-400|1200] "C" Vector

BO_ 515 PDB_Status: 8 Vector
 SG_ bus_V : 0|16@1+ (0.01,0) [0|1000] "V" Vector
